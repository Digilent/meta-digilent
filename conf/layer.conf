## conf/machine/include/genesyszu-3eg/genesyszu-3eg-cortexa53-fsbl-features.conf
```bitbake
MACHINE_FEATURES = "avbuf axidma axipmon clockps common coresightps-dcc csudma ddrcpsu dpdma dppsu emacps gpio gpiops iic iicps ipipsu pciepsu qspipsu resetps rtcpsu scugic sdps spips sysmonpsu ttcps uartps usbpsu video-common zdma"
```

## conf/machine/include/genesyszu-3eg/genesyszu-3eg-microblaze-pmu-features.conf
```bitbake
MACHINE_FEATURES = "avbuf axidma axipmon clockps common csudma ddrcpsu dpdma dppsu emacps gpio gpiops iic iicps ipipsu pciepsu qspipsu resetps rtcpsu sdps spips sysmonpsu ttcps uartps usbpsu video-common zdma"
```
